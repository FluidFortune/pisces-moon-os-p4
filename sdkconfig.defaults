## sdkconfig.defaults
```kconfig
# Pisces Moon OS — Pisces Moon P4 / ESP32-P4 sdkconfig defaults
# Pisces Moon OS / Fluid Fortune / AGPL-3.0-or-later

# Target chip
CONFIG_IDF_TARGET="esp32p4"

# CPU
CONFIG_ESP_DEFAULT_CPU_FREQ_MHZ_360=y
CONFIG_FREERTOS_HZ=1000
CONFIG_FREERTOS_UNICORE=n

# PSRAM — 32MB on this board
# Values aligned with ELECROW factory_sourcecode sdkconfig
# (CrowPanel Advanced 7" ESP32-P4 1024x600 HMI)
CONFIG_SPIRAM=y
CONFIG_SPIRAM_MODE_HEX=y
CONFIG_SPIRAM_SPEED_200M=y
CONFIG_SPIRAM_BOOT_HW_INIT=y
CONFIG_SPIRAM_BOOT_INIT=y
CONFIG_SPIRAM_FLASH_LOAD_TO_PSRAM=y
CONFIG_SPIRAM_FETCH_INSTRUCTIONS=y
CONFIG_SPIRAM_RODATA=y
CONFIG_SPIRAM_XIP_FROM_PSRAM=y
# CONFIG_SPIRAM_USE_CAPS_ALLOC is not set
CONFIG_SPIRAM_USE_MALLOC=y
CONFIG_SPIRAM_MALLOC_ALWAYSINTERNAL=16384
CONFIG_SPIRAM_MALLOC_RESERVE_INTERNAL=65536
CONFIG_SPIRAM_PRE_CONFIGURE_MEMORY_PROTECTION=y

# Cache config — aligned with ELECROW for PSRAM XIP support
CONFIG_CACHE_L2_CACHE_256KB=y
CONFIG_CACHE_L2_CACHE_LINE_128B=y

# MMU 64KB pages — required for PSRAM XIP on this silicon
CONFIG_MMU_PAGE_SIZE_64KB=y

# Flash — 16MB NOR
CONFIG_ESPTOOLPY_FLASHSIZE_16MB=y
CONFIG_PARTITION_TABLE_CUSTOM=y
CONFIG_PARTITION_TABLE_CUSTOM_FILENAME="partitions.csv"

# Console / debug serial
# Match ELECROW factory topology: UART primary, USB Serial/JTAG secondary.
CONFIG_ESP_CONSOLE_UART_DEFAULT=y
CONFIG_ESP_CONSOLE_SECONDARY_USB_SERIAL_JTAG=y
CONFIG_ESP_CONSOLE_USB_SERIAL_JTAG_ENABLED=y

# Stack sizes
CONFIG_ESP_MAIN_TASK_STACK_SIZE=8192
CONFIG_ESP_TIMER_TASK_STACK_SIZE=4096

# Power management — keep things responsive
CONFIG_PM_ENABLE=n

# Logging
CONFIG_LOG_DEFAULT_LEVEL_INFO=y
CONFIG_LOG_MAXIMUM_LEVEL_INFO=y

# FATFS / SD
CONFIG_FATFS_LFN_HEAP=y
CONFIG_FATFS_LONG_FILENAMES=y
CONFIG_FATFS_MAX_LFN=255
CONFIG_FATFS_DEFAULT_CODEPAGE=437

# Newlib for printf with floats (used by JSON / logging)
CONFIG_NEWLIB_NANO_FORMAT=n

# ─── LVGL v9 ────────────────────────────────────────────────
# Set color depth, decoders, font options. For full menu, run
# `idf.py menuconfig` → Component config → LVGL.
CONFIG_LV_COLOR_DEPTH_16=y
CONFIG_LV_COLOR_16_SWAP=n
CONFIG_LV_USE_SYSMON=n

# ─── esp_lvgl_port ──────────────────────────────────────────
# Dedicated task for LVGL processing, pinned to Core 1 so the
# C6 bridge (Core 0) doesn't starve LVGL during heavy radio
# event flow.
CONFIG_LV_DEF_REFR_PERIOD=16
CONFIG_LV_DISP_DEF_REFR_PERIOD=16
CONFIG_LV_INDEV_DEF_READ_PERIOD=20

# ─── MIPI-DSI ───────────────────────────────────────────────
# Power the DPHY from the internal LDO. Connect VDD_MIPI_DPHY
# to the LDO output on the schematic — this is documented in
# the ESP32-P4 LCD guide.
# (removed — LDO_VO3 acquired at runtime in pm_bsp.c)
CONFIG_LV_FONT_MONTSERRAT_28=y
CONFIG_LV_FONT_MONTSERRAT_48=y

# ESP32-P4 chip revision support - ELECROW board is pre-v3 silicon.
CONFIG_ESP32P4_SELECTS_REV_LESS_V3=y
CONFIG_ESP32P4_REV_MIN_1=y

# ─── ESP-Hosted (C6 over SDIO) ───
# The onboard ESP32-C6-MINI-1 module ships with stock ESP-Hosted
# slave firmware pre-flashed by ELECROW. The P4 talks to it over
# SDIO and uses standard esp_wifi_* and Bluedroid APIs as if WiFi
# were on the P4 directly. No C6 reflashing required.
#
# Pin map confirmed against ELECROW reference firmware:
#   CMD=IO19, CLK=IO18, D0=IO14, D1=IO15, RESET=IO32

CONFIG_ESP_WIFI_REMOTE_ENABLED=y
CONFIG_ESP_WIFI_REMOTE_LIBRARY_HOSTED=y
CONFIG_ESP_HOSTED_ENABLED=y
CONFIG_SLAVE_IDF_TARGET_ESP32C6=y
CONFIG_ESP_HOSTED_CP_TARGET_ESP32C6=y
CONFIG_ESP_HOSTED_IDF_SLAVE_TARGET="esp32c6"
CONFIG_ESP_HOSTED_PRIV_SDIO_OPTION=y
CONFIG_ESP_HOSTED_SDIO_HOST_INTERFACE=y
CONFIG_ESP_HOSTED_SDIO_RESET_ACTIVE_HIGH=y
CONFIG_ESP_HOSTED_SDIO_SLOT_1=y
CONFIG_ESP_HOSTED_SDIO_1_BIT_BUS=y
CONFIG_ESP_HOSTED_SDIO_CLOCK_FREQ_KHZ=40000
CONFIG_ESP_HOSTED_SDIO_TX_Q_SIZE=6
CONFIG_ESP_HOSTED_SDIO_RX_Q_SIZE=6
CONFIG_ESP_HOSTED_PRIV_SDIO_PIN_CMD_SLOT_1=19
CONFIG_ESP_HOSTED_PRIV_SDIO_PIN_CLK_SLOT_1=18
CONFIG_ESP_HOSTED_PRIV_SDIO_PIN_D0_SLOT_1=14
CONFIG_ESP_HOSTED_PRIV_SDIO_PIN_D1_1BIT_BUS_SLOT_1=15
CONFIG_ESP_HOSTED_SDIO_GPIO_RESET_SLAVE=32
CONFIG_ESP_HOSTED_DFLT_TASK_FROM_SPIRAM=y
# CONFIG_ESP_HOSTED_USE_MEMPOOL is not set
CONFIG_BT_ENABLED=y
CONFIG_BT_CONTROLLER_DISABLED=y
CONFIG_BT_BLUEDROID_ENABLED=y
CONFIG_BT_BLE_50_FEATURES_SUPPORTED=n
CONFIG_BT_BLE_42_FEATURES_SUPPORTED=y
CONFIG_ESP_HOSTED_ENABLE_BT_BLUEDROID=y
CONFIG_ESP_HOSTED_BLUEDROID_HCI_VHCI=y

# Allow Espressif's experimental ESP-Hosted features
CONFIG_IDF_EXPERIMENTAL_FEATURES=y

# Bootloader diagnostics — info-level logs to catch early panics
CONFIG_BOOTLOADER_LOG_LEVEL_INFO=y
CONFIG_BOOTLOADER_LOG_LEVEL=3

# Keep USB-Serial-JTAG alive during boot — prevents the kernel from
# auto-gating the USB clock when entering brief light-sleep states.
# Without this, USB endpoint disappears before panic handler can flush.
CONFIG_USJ_NO_AUTO_LS_ON_CONNECTION=y

# When a panic happens, HALT instead of rebooting immediately.
# This gives USB-Serial-JTAG time to flush the panic message + backtrace.
# Without this, panic prints and reboots in <1ms — too fast to see anything.
CONFIG_ESP_SYSTEM_PANIC_PRINT_HALT=y
# CONFIG_ESP_SYSTEM_PANIC_PRINT_REBOOT is not set

# Store panic dumps in flash so they can be decoded after re-entering ROM download mode.
CONFIG_ESP_COREDUMP_ENABLE_TO_FLASH=y
CONFIG_ESP_COREDUMP_DATA_FORMAT_ELF=y
CONFIG_ESP_COREDUMP_CHECKSUM_CRC32=y
CONFIG_ESP_COREDUMP_MAX_TASKS_NUM=64
CONFIG_ESP_COREDUMP_USE_STACK_SIZE=y
CONFIG_ESP_COREDUMP_STACK_SIZE=1792

# LVGL v9 memory pool — must be set or lv_init() leaves TLSF NULL.
# This was the root cause of the LVGL allocator crash on first
# lv_style_set_*() call. 64KB internal pool is the LVGL default;
# bumping to 512KB since we have 32MB PSRAM and many widgets/screens.
# CONFIG_LV_USE_BUILTIN_MALLOC is not set
CONFIG_LV_USE_CLIB_MALLOC=y
CONFIG_LV_USE_OS=LV_OS_FREERTOS

# Enable additional Montserrat font sizes for finer typography
CONFIG_LV_FONT_MONTSERRAT_10=y
CONFIG_LV_FONT_MONTSERRAT_12=y
CONFIG_LV_FONT_MONTSERRAT_16=y
CONFIG_LV_FONT_MONTSERRAT_18=y
CONFIG_LV_FONT_MONTSERRAT_20=y
CONFIG_LV_FONT_MONTSERRAT_24=y
CONFIG_LV_FONT_MONTSERRAT_36=y
```

## sdkconfig.defaults.lilygo_tdisplay_p4
```kconfig
# Pisces Moon OS — LilyGO T-Display-P4 sdkconfig overlay
# Pisces Moon OS / Fluid Fortune / AGPL-3.0-or-later
#
# This file is applied on top of sdkconfig.defaults when the
# LilyGO board profile is selected via:
#   PM_P4_BOARD=lilygo_tdisplay_p4 idf.py -B build-tdisplay build
#
# IDF picks up `sdkconfig.defaults.lilygo_tdisplay_p4` automatically
# when SDKCONFIG_DEFAULTS lists it; see the root CMakeLists.txt
# (this file gets added there once LilyGO builds are validated).
#
# Adjustments vs. the Elecrow baseline:
#   - C6 reset GPIO routed via XL9535 IO14, not direct GPIO 32.
#     Disable ESP-Hosted's reset pulse so it doesn't poke an
#     unrelated GPIO. The XL9535 boot sequence already brought
#     the C6 up cleanly before ESP-Hosted runs.
#   - SDIO 4-bit (LilyGO wires all four data lines) for higher
#     C6 throughput. The PHY pads CMD=19, CLK=18, D0=14, D1=15,
#     D2=16, D3=17 already match Elecrow's pins by coincidence.

CONFIG_ESP_HOSTED_SDIO_GPIO_RESET_SLAVE=-1
# CONFIG_ESP_HOSTED_SDIO_1_BIT_BUS is not set
CONFIG_ESP_HOSTED_SDIO_4_BIT_BUS=y
CONFIG_ESP_HOSTED_PRIV_SDIO_PIN_D2_SLOT_1=16
CONFIG_ESP_HOSTED_PRIV_SDIO_PIN_D3_SLOT_1=17
```
